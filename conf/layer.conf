## conf/layer.conf
```bitbake
# We have a conf and classes directory, add to BBPATH.
BBPATH .= ":${LAYERDIR}"

# We have recipes-* directories, add to BBFILES.
BBFILES += "${LAYERDIR}/recipes-*/*/*.bb \
            ${LAYERDIR}/recipes-*/*/*/*.bb \
            ${LAYERDIR}/recipes-*/*/*.bbappend \
            ${LAYERDIR}/recipes-*/*/*/*.bbappend"

BBFILE_COLLECTIONS += "meta-rpi5-can-monitor"
BBFILE_PATTERN_meta-rpi5-can-monitor = "^${LAYERDIR}/"
BBFILE_PRIORITY_meta-rpi5-can-monitor = "6"

LAYERDEPENDS_meta-rpi5-can-monitor = "core"
LAYERSERIES_COMPAT_meta-rpi5-can-monitor = "scarthgap"
```
